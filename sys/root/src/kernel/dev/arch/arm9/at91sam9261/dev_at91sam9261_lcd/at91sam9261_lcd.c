/*
The contents of this file are subject to the Mozilla Public License Version 1.1
(the "License"); you may not use this file except in compliance with the License.
You may obtain a copy of the License at http://www.mozilla.org/MPL/

Software distributed under the License is distributed on an "AS IS" basis,
WITHOUT WARRANTY OF ANY KIND, either express or implied. See the License for the
specific language governing rights and limitations under the License.

The Original Code is Lepton.

The Initial Developer of the Original Code is Philippe Le Boulanger.
Portions created by Philippe Le Boulanger are Copyright (C) 2011 <lepton.phlb@gmail.com>.
All Rights Reserved.

Contributor(s): Jean-Jacques Pitrolle <lepton.jjp@gmail.com>.

Alternatively, the contents of this file may be used under the terms of the eCos GPL license
(the  [eCos GPL] License), in which case the provisions of [eCos GPL] License are applicable
instead of those above. If you wish to allow use of your version of this file only under the
terms of the [eCos GPL] License and not to allow others to use your version of this file under
the MPL, indicate your decision by deleting  the provisions above and replace
them with the notice and other provisions required by the [eCos GPL] License.
If you do not delete the provisions above, a recipient may use your version of this file under
either the MPL or the [eCos GPL] License."
*/


/*============================================
| Includes
==============================================*/
#include <string.h>
#include <stdio.h>

#include "kernel/core/kernelconf.h"

#if defined(__KERNEL_UCORE_EMBOS)
   #include <ioat91sam9261.h>
   #include "at91sam9261_init.h"
#elif defined(__KERNEL_UCORE_ECOS)
   #include "cyg/hal/at91sam9261.h"
#endif

#include "at91sam9261_lcd_lut.h"
#include "at91sam9261_lcd.h"

#include "kernel/dev/arch/arm9/at91sam9261/dev_at91sam9261_cpu/dev_at91sam9261_cpu.h"
/*============================================
| Global Declaration
==============================================*/
#define __inline inline


extern AT91PS_SYS AT91_SYS;

static char *lcd_console_address;               /* Start of console buffer         */

static int lcd_line_length;
static int lcd_color_fg;
static int lcd_color_bg;

static short console_col;
static short console_row;

static char lcd_is_enabled = 0;

static char* p_at91sam9261_frame_buffer[2]={
   (char*)AT91C_FRAME_BUFFER_0,
   (char*)AT91C_FRAME_BUFFER_1
};

static unsigned char at91sam9261_current_frame_buffer=0;
static unsigned char at91sam9261_shadow_frame_buffer=1;


static const PALETTEENTRY monochromePalette[256] =
{
   { 0x00, 0x00, 0x00, 0 },
   { 0xff, 0xff, 0xff, 0 }
};

const PALETTEENTRY rgbPalette[256] =
{
   { 0x00, 0x00, 0x00, 0 },     /* 0 Sys Black      gray 0  */
   { 0x80, 0x00, 0x00, 0 },     /* 1 Sys Dk Red  */
   { 0x00, 0x80, 0x00, 0 },     /* 2 Sys Dk Green  */
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   { 0xff, 0xff, 0xff, 0 }      /* 255 Sys White     gray 255  */
};

const PALETTEENTRY paletteDIAG[256] =
{ {0x00,0x00,0x00,0x00},
  {0x80,0x00,0x00,0x00},
  {0x00,0x80,0x00,0x00},
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  {0xff,0xff,0xff,0x00}};

const PALETTEENTRY PalettePC2[256] =
{ {0x00,0x00,0x00,0x00},
  {0x80,0x00,0x00,0x00},
  {0x00,0x80,0x00,0x00},
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  {0xff,0xff,0xff,0x00}};

static const PALETTEENTRY palette[256] =
{ {0x00,0x00,0x00,0x00},
  {0x80,0x00,0x00,0x00},
  {0x00,0x80,0x00,0x00},
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  {0xff,0xff,0xff,0x00}};

//
static dev_panel_info_t g_panel_info={0};
static const unsigned char at91sam9261_lcd_tblum[16] =
{255,250,245,240,235,230,225,215,205,195,185,175,165,135,75,5};

static const unsigned char at91sam9261_lcd_lum = 13;

static PALETTEENTRY* g_at91sam79261_current_palette;
/*============================================
| Implementation
==============================================*/
/*--------------------------------------------
| Name:        at91sam9261_lcd_set_lut
| Description:
| Parameters:  none
| Return Type: none
| Comments:
| See:
----------------------------------------------*/
void at91sam9261_lcd_set_lut(const PALETTEENTRY *palette)
{
   unsigned int i;

   g_at91sam79261_current_palette = (PALETTEENTRY*)palette;

   for(i =0; i <256; i++)
      g_panel_info.controller.lcdc->LCDC_LUT_ENTRY[i] = ((palette[i].red) >> 3 |
                                                         ((palette[i].green & 0xf8) << 2) |
                                                         ((palette[i].blue & 0xf8) << 7));
}

/*--------------------------------------------
| Name:        at91sam9261_lcd_switch_active_frame_buffer
| Description:
| Parameters:  none
| Return Type: none
| Comments:
| See:
----------------------------------------------*/
unsigned long at91sam9261_lcd_switch_active_frame_buffer(void){
   at91sam9261_shadow_frame_buffer = at91sam9261_current_frame_buffer;
   at91sam9261_current_frame_buffer=!at91sam9261_current_frame_buffer;

   g_panel_info.controller.lcdc->LCDC_BA1=
      (unsigned long)p_at91sam9261_frame_buffer[at91sam9261_current_frame_buffer];
   return (unsigned long)p_at91sam9261_frame_buffer[at91sam9261_shadow_frame_buffer];
}

/*--------------------------------------------
| Name:        at91sam9261_lcd_get_current_frame_buffer
| Description:
| Parameters:  none
| Return Type: none
| Comments:
| See:
----------------------------------------------*/
unsigned long at91sam9261_lcd_get_current_frame_buffer(void)
{
   return (unsigned long)p_at91sam9261_frame_buffer[at91sam9261_current_frame_buffer];
}

/*--------------------------------------------
| Name:        at91sam9261_lcd_get_shadow_frame_buffer
| Description:
| Parameters:  none
| Return Type: none
| Comments:
| See:
----------------------------------------------*/
unsigned long at91sam9261_lcd_get_shadow_frame_buffer(void)
{
   return (unsigned long)p_at91sam9261_frame_buffer[at91sam9261_shadow_frame_buffer];
}



/*--------------------------------------------
| Name:        at91sam9261_lcd_gpio
| Description:
| Parameters:  none
| Return Type: none
| Comments:
| See:
----------------------------------------------*/
static void at91sam9261_lcd_gpio (void)
{
   AT91_SYS->PIOB_PDR =
      (AT91C_PB0_LCDVSYNC | AT91C_PB1_LCDHSYNC | AT91C_PB2_LCDDOTCK | AT91C_PB3_LCDDEN  |
       AT91C_PB4_LCDCC    | AT91C_PB7_LCDD2    | AT91C_PB8_LCDD3   |
       AT91C_PB9_LCDD4    | AT91C_PB10_LCDD5   | AT91C_PB11_LCDD6  |
       AT91C_PB12_LCDD7   | AT91C_PB15_LCDD10  | AT91C_PB16_LCDD11 |
       AT91C_PB17_LCDD12  | AT91C_PB18_LCDD13  | AT91C_PB19_LCDD14 |
       AT91C_PB20_LCDD15  | AT91C_PB23_LCDD18  | AT91C_PB24_LCDD19 |
       AT91C_PB25_LCDD20  | AT91C_PB26_LCDD21  | AT91C_PB27_LCDD22 |
       AT91C_PB28_LCDD23);

   AT91_SYS->PIOB_BSR = (AT91C_PB23_LCDD18 | AT91C_PB24_LCDD19 | AT91C_PB25_LCDD20 |
                         AT91C_PB26_LCDD21 | AT91C_PB27_LCDD22 | AT91C_PB28_LCDD23);

   /* Enable signaux cde cran LCD */
   AT91_SYS->PIOB_PER = AT91C_PIO_PB5 | AT91C_PIO_PB6;        // Enable PIO fonction
   AT91_SYS->PIOB_OER = AT91C_PIO_PB5 | AT91C_PIO_PB6;        // in Output fonction
   AT91_SYS->PIOB_CODR = AT91C_PIO_PB5 | AT91C_PIO_PB6;       // EN-DATALCD=0 , ALIM-LCD= 0
}

/*--------------------------------------------
| Name:        at91sam9261_lcd_calc_frame_buffer_size
| Description:
| Parameters:  none
| Return Type: none
| Comments:
| See:
----------------------------------------------*/
unsigned long at91sam9261_lcd_calc_frame_buffer_size(void)
{
   unsigned long size;
   int line_length =
      ((unsigned int)g_panel_info.vl_col * (unsigned int)NBITS(g_panel_info.vl_bpix)) / 8;

   size = line_length * (unsigned int)g_panel_info.vl_row;
   size += PAGE_SIZE;

   return size;
}


/*--------------------------------------------
| Name:        at91sam9261_lcd_ctrl_init
| Description:
| Parameters:  none
| Return Type: none
| Comments:
| See:
----------------------------------------------*/
int at91sam9261_lcd_ctrl_init (dev_panel_info_t* p_panel_info)
{
   unsigned long value;
   unsigned int i,j;
   //
   if(!p_panel_info)
      return -1;
   //
   memcpy(&g_panel_info,p_panel_info,sizeof(dev_panel_info_t));
   //
   at91sam9261_lcd_gpio();                    // Configure les I/O pour le controleur LCD
   //
   AT91_SYS->PMC_PCER = 1 << AT91C_ID_LCDC;    // Enable LCD peripheral clock
   AT91_SYS->PMC_SCER = AT91C_PMC_HCK1;        // Enable HCLOCK in PMC (AHB LCDC Clock Output)
   /* DMA disable */
   g_panel_info.controller.lcdc->LCDC_DMACON = 0;
   /* LCD power off */
   //g_panel_info.controller.lcdc->LCDC_PWRCON = 0;  // Guard time = 0 => immediat


   lcd_console_address = p_at91sam9261_frame_buffer[at91sam9261_current_frame_buffer]; //Adresse du Frame buffer ds la SDRAM
   lcd_line_length = (g_panel_info.vl_col * NBITS (g_panel_info.vl_bpix)) / 8;   // Nb d'octet de data par ligne d'cran

   /* Init controller field in panel_info */
   g_panel_info.controller.lcdc = (AT91PS_LCDC) AT91C_BASE_LCDC;     // Initialise la structure pour pointer
   g_panel_info.controller.frame_buffer =
      (unsigned long)p_at91sam9261_frame_buffer[at91sam9261_current_frame_buffer];                                      // sur les registres du controleur LCD

   /* Turn off the LCD controller and the DMA controller */
   g_panel_info.controller.lcdc->LCDC_PWRCON = 0x0C;  // LCD_PWR = 0 et GUARD_TIME = 6
   g_panel_info.controller.lcdc->LCDC_DMACON = 0;     // DMA Enable = 0

   // Reset LCDC DMA
   g_panel_info.controller.lcdc->LCDC_DMACON = AT91C_LCDC_DMARST;

   /* set frame size and burst length */
   value =
      ((unsigned int)g_panel_info.vl_row * (unsigned int)g_panel_info.vl_col *
       (unsigned int)NBITS(g_panel_info.vl_bpix)) / 32;
   value |= (unsigned long)((128 - 1) << 24);       // Burst Lengh = 128 word (32 bit)
   g_panel_info.controller.lcdc->LCDC_FRMCFG = value;

   /* Set pixel clock */
   value = AT91C_MASTER_CLOCK_FOR_I2S / g_panel_info.vl_pixclock;
   if (AT91C_MASTER_CLOCK_FOR_I2S % g_panel_info.vl_pixclock)
      value++;
   value = (value / 2) - 1;
   /* if (!value)
   g_panel_info.controller.lcdc->LCDC_LCDCON1 = AT91C_LCDC_BYPASS;
   else*/
   g_panel_info.controller.lcdc->LCDC_LCDCON1 = value << 12;     // =>AT91C_LCDC_BYPASS = 0

   /* Initialize control register 2 */
   if (g_panel_info.vl_tft)
      // Memory format= Little Endian, Display=TFT, LCDDOTCK always active
      value = ( AT91C_LCDC_MEMOR_LITTLEIND | AT91C_LCDC_DISTYPE_TFT | AT91C_LCDC_CLKMOD);
   else
      value = ( AT91C_LCDC_MEMOR_LITTLEIND | AT91C_LCDC_CLKMOD);

   if (!((unsigned int)g_panel_info.vl_hsp & FB_SYNC_HOR_HIGH_ACT))
      value |= 1 << 10;                // INVLINE=1  => HSYNC active low
   if (!((unsigned int)g_panel_info.vl_vsp & FB_SYNC_VERT_HIGH_ACT))
      value |= 1 << 9;                    // INVFRAME=1 => VSYNC active low

   value |= (unsigned int)(g_panel_info.vl_bpix << 5);  // Pixel size

   g_panel_info.controller.lcdc->LCDC_LCDCON2 = value;

   //at91sam9261_lcd_set_lut(PalettePC2);              // Initialise lookup table color
   //at91sam9261_lcd_set_lut(monochromePalette);              // Initialise lookup table color
   at91sam9261_lcd_set_lut(rgbPalette);


   /* Vertical timing */
   value = (unsigned int)((g_panel_info.vl_vpw - 1) << 16);
   value |= (unsigned int)(g_panel_info.vl_bfw << 8);
   value |= (unsigned int)g_panel_info.vl_efw;
   value |= 8 << 24;                          // VHDLY
   g_panel_info.controller.lcdc->LCDC_TIM1 = value;

   /* Horizontal timing */
   value = (unsigned int)((g_panel_info.vl_elw - 1) << 21);
   value |= (unsigned int)((g_panel_info.vl_hpw - 1) << 8);
   value |= (unsigned int)(g_panel_info.vl_blw - 1);

   g_panel_info.controller.lcdc->LCDC_TIM2 = value;

   value = (unsigned int)((g_panel_info.vl_col - 1) << 21);
   value |= (unsigned int)(g_panel_info.vl_row - 1);

   g_panel_info.controller.lcdc->LCDC_LCDFRCFG = value;

   /* FIFO Threshold: Use formula from data sheet */
   value = SIDSAFB_FIFO_SIZE - (2 * SIDSAFB_DMA_BURST_LEN + 3);         //value = 512;
   g_panel_info.controller.lcdc->LCDC_FIFO = value;

   /* Toggle LCD_MODE every frame */
   value = 0;
   g_panel_info.controller.lcdc->LCDC_MVAL = value;

   for (i=0; i<100000; i++)
   {
      j = (j >> 1)*5;
      j--;
      j = (j >> 1)*5;                        // Tempo
   }
   AT91_SYS->PIOB_SODR = AT91C_PIO_PB5;        // EN-DATALCD=1

   // Set contrast
   value = AT91C_LCDC_PS_DIVIDEDBYEIGHT | AT91C_LCDC_POL_NEGATIVEPULSE |
           AT91C_LCDC_ENA_PWMGEMENABLED;
   g_panel_info.controller.lcdc->LCDC_CTRSTCON = value;
   g_panel_info.controller.lcdc->LCDC_CTRSTVAL = 0xFF;     // Extinction

   /* Disable all interrupts */
   g_panel_info.controller.lcdc->LCDC_IDR = ~0UL;

   g_panel_info.controller.lcdc->LCDC_BA1 =
      (unsigned long)p_at91sam9261_frame_buffer[at91sam9261_current_frame_buffer];
   g_panel_info.controller.lcdc->LCDC_FRMCFG =
      (SIDSAFB_DMA_BURST_LEN <<
       24) +
      ((unsigned int)g_panel_info.vl_col * (unsigned int)g_panel_info.vl_row *
       (unsigned int)NBITS(g_panel_info.vl_bpix)) / 32;
   /* DMA enable */
   g_panel_info.controller.lcdc->LCDC_DMACON = AT91C_LCDC_DMAEN;
   /* LCD power on */
   g_panel_info.controller.lcdc->LCDC_PWRCON = AT91C_LCDC_PWR | (6 << 1); // Guard time = 6 => delay 100 ms

   g_panel_info.controller.lcdc->LCDC_CTRSTVAL = at91sam9261_lcd_tblum[at91sam9261_lcd_lum];

   return 0;
}

/*--------------------------------------------
| Name:        at91sam9261_lcd_get_palette
| Description:
| Parameters:  none
| Return Type: none
| Comments:
| See:
----------------------------------------------*/
PALETTEENTRY * at91sam9261_lcd_get_palette(void) {
   return (PALETTEENTRY *)g_at91sam79261_current_palette;
}

/*--------------------------------------------
| Name:        at91sam9261_lcd_get_panel_info
| Description:
| Parameters:  none
| Return Type: none
| Comments:
| See:
----------------------------------------------*/
dev_panel_info_t* at91sam9261_lcd_get_panel_info(void){
   return &g_panel_info;
}

/*============================================
| End of Source  : at91sam9261_lcd.c
==============================================*/
